## CMakeLists.txt
```
cmake_minimum_required(VERSION 3.20.0)

set(EXTRA_CONF_FILE ${CMAKE_CURRENT_LIST_DIR}/../common/common.conf)

find_package(Zephyr REQUIRED HINTS $ENV{ZEPHYR_BASE})
project(ring)

target_sources(app PRIVATE src/main.c src/imu.c)
target_include_directories(app PRIVATE src)
include(${CMAKE_CURRENT_LIST_DIR}/../common/common.cmake)
```

## Kconfig.sysbuild
```
# Single image, flash layout from devicetree (the board's UF2 bootloader
# layout), no Nordic partition manager.
config PARTITION_MANAGER
	default n

source "share/sysbuild/Kconfig"
```

## prj.conf
```kconfig
# Ring: Seeed XIAO nRF52840 Sense. Shared settings are in ../common/common.conf.

CONFIG_I2C=y
CONFIG_GPIO=y
# The board powers the IMU through a regulator at boot.
CONFIG_REGULATOR=y
```

## src/main.c
```c
/*
 * Ring firmware (Seeed XIAO nRF52840 Sense).
 *
 * Radio mode (normal): read every IMU sample the moment it is ready and send
 * it to the receiver immediately over Enhanced ShockBurst (~1666 packets/s).
 *
 * Wired mode (plugged into a computer's USB port): act as a USB mouse
 * directly. Same motion processing as the receiver, no radio. Used as the
 * "fastest possible" reference in lag tests.
 *
 * Idle mode (radio, after 30 s lying still): poll the IMU at ~52 Hz and send a
 * heartbeat 4 times per second. Any movement wakes it within ~20 ms.
 */
#include <stdlib.h>
#include <string.h>

#include <zephyr/drivers/gpio.h>
#include <zephyr/drivers/hwinfo.h>
#include <zephyr/kernel.h>
#include <zephyr/sys/atomic.h>
#include <zephyr/sys/reboot.h>
#include <zephyr/sys/util.h>

#include <esb.h>
#include <hal/nrf_power.h>

#include "cfg_store.h"
#include "fw_version.h"
#include "imu.h"
#include "link_packet.h"
#include "pointer_engine.h"
#include "proto.h"
#include "radio.h"
#include "usb_io.h"

/* ---- tuning of the ring's own power management ---- */
#define BLOCK_SAMPLES 166          /* ~100 ms at 1666 Hz */
#define STILL_PP_LSB 143           /* 5 deg/s peak-to-peak within a block */
#define IDLE_AFTER_BLOCKS 300      /* 30 s of still blocks */
#define IDLE_POLL_US 19208         /* 32 IMU samples: 32 / 1666 Hz */
#define IDLE_HEARTBEAT_POLLS 13    /* ~250 ms */
#define WAKE_GYRO_LSB 143          /* 5 deg/s away from the resting value */
#define WAKE_ACCEL_LSB 820         /* 0.1 g away from the resting value */
#define TX_STUCK_US 5000           /* recover if a TX event never arrives */
#define IMU_RETRY_MS 1000
#define BOOTLOADER_UF2_MAGIC 0x57  /* GPREGRET value: bootloader opens its UF2 drive */

/* ---- LEDs (active-low, polarity handled by devicetree) ---- */
static const struct gpio_dt_spec led_red = GPIO_DT_SPEC_GET(DT_ALIAS(led0), gpios);
static const struct gpio_dt_spec led_green = GPIO_DT_SPEC_GET(DT_ALIAS(led1), gpios);
static const struct gpio_dt_spec led_blue = GPIO_DT_SPEC_GET(DT_ALIAS(led2), gpios);

enum ring_mode { MODE_RADIO, MODE_IDLE, MODE_WIRED };

static atomic_t mode = ATOMIC_INIT(MODE_RADIO);
static atomic_t imu_ok;
static atomic_t tx_busy;
static atomic_t tx_ok_count;
static atomic_t tx_fail_count;
static uint32_t tx_start_cyc;

K_SEM_DEFINE(drdy_sem, 0, 1);

/* Cumulative state sent in every packet. Only the motion thread touches it. */
static struct link_packet pkt;

/* ------------------------------------------------------------------ */
/* Radio                                                               */

static void esb_event(const struct esb_evt *evt)
{
	switch (evt->evt_id) {
	case ESB_EVENT_TX_SUCCESS:
		atomic_inc(&tx_ok_count);
		break;
	case ESB_EVENT_TX_FAILED:
		atomic_inc(&tx_fail_count);
		break;
	case ESB_EVENT_RX_RECEIVED: {
		/* The receiver never sends payloads back; drain just in case. */
		struct esb_payload rx;

		while (esb_read_rx_payload(&rx) == 0) {
		}
		break;
	}
	default:
		break;
	}
	atomic_set(&tx_busy, 0);
}

/* Send the current cumulative state if the radio is free. If it is still busy
 * with the previous packet, skip: the next sample's packet carries everything.
 */
static void send_packet(void)
{
	if (atomic_get(&tx_busy)) {
		uint32_t busy_us = k_cyc_to_us_floor32(k_cycle_get_32() - tx_start_cyc);

		if (busy_us < TX_STUCK_US) {
			return;
		}
		/* Should never happen; don't let one lost event stop the ring. */
		atomic_set(&tx_busy, 0);
	}

	struct esb_payload pl = {
		.pipe = 0,
		.length = LINK_PACKET_SIZE,
		.noack = false,
	};

	pkt.seq++;
	pkt.tx_fail_count = (uint8_t)atomic_get(&tx_fail_count);
	link_packet_encode(&pkt, pl.data);

	/* A failed packet stays at the head of the ESB queue; drop it so the
	 * fresh one goes out now.
	 */
	(void)esb_flush_tx();
	tx_start_cyc = k_cycle_get_32();
	atomic_set(&tx_busy, 1);
	if (esb_write_payload(&pl) != 0) {
		atomic_set(&tx_busy, 0);
	}
}

/* ------------------------------------------------------------------ */
/* Wired mode: run the pointer engine here                             */

static struct pe_state engine;
static uint32_t engine_cfg_gen;

static void engine_sync_config(void)
{
	if (cfg_store_generation() != engine_cfg_gen) {
		struct pe_config c;

		cfg_store_get(&c, &engine_cfg_gen);
		pe_set_config(&engine, &c);
	}
	if (proto_take_rezero_request()) {
		pe_reset_bias(&engine);
	}
}

/* The txdiv setting, re-read whenever the settings change. */
static uint8_t tx_div_now(void)
{
	static uint32_t gen = UINT32_MAX;
	static uint8_t div = 1;

	if (cfg_store_generation() != gen) {
		struct pe_config c;

		cfg_store_get(&c, &gen);
		div = c.tx_div > 1 ? c.tx_div : 1;
	}
	return div;
}

static uint8_t tx_skip;

static void wired_process(const int16_t g[3], const int16_t a[3])
{
	int32_t dg[3] = {g[0], g[1], g[2]};
	struct pe_output out;

	engine_sync_config();
	pe_update(&engine, dg, 1, a, &out);
	usb_io_move(out.dx, out.dy);
	proto_telem_update(&engine, &out, 1, a);
}

/* ------------------------------------------------------------------ */
/* Motion thread                                                       */

static void add_samples(const int16_t g[3], const int16_t a[3], uint32_t n)
{
	for (int i = 0; i < 3; i++) {
		/* wrap-around on purpose; unsigned math avoids signed overflow */
		pkt.gyro_sum[i] = (int32_t)((uint32_t)pkt.gyro_sum[i] +
					    (uint32_t)((int32_t)g[i] * (int32_t)n));
		pkt.accel[i] = a[i];
	}
	pkt.sample_count += n;
}

struct still_block {
	int16_t min[3], max[3];
	int n;
};

static void block_reset(struct still_block *b)
{
	for (int i = 0; i < 3; i++) {
		b->min[i] = INT16_MAX;
		b->max[i] = INT16_MIN;
	}
	b->n = 0;
}

/* Returns true at the end of a block if the block was still. */
static bool block_add(struct still_block *b, const int16_t g[3], bool *done)
{
	for (int i = 0; i < 3; i++) {
		b->min[i] = MIN(b->min[i], g[i]);
		b->max[i] = MAX(b->max[i], g[i]);
	}
	*done = ++b->n >= BLOCK_SAMPLES;
	if (!*done) {
		return false;
	}
	bool still = true;

	for (int i = 0; i < 3; i++) {
		if (b->max[i] - b->min[i] > STILL_PP_LSB) {
			still = false;
		}
	}
	block_reset(b);
	return still;
}

static bool try_imu_init(void)
{
	int err = imu_init(&drdy_sem);

	atomic_set(&imu_ok, err == 0);
	if (err) {
		pkt.flags |= LINK_FLAG_IMU_ERROR;
	} else {
		pkt.flags &= (uint8_t)~LINK_FLAG_IMU_ERROR;
	}
	return err == 0;
}

static void motion_thread_fn(void *p1, void *p2, void *p3)
{
	ARG_UNUSED(p1);
	ARG_UNUSED(p2);
	ARG_UNUSED(p3);

	struct still_block blk;
	int still_blocks = 0;
	int16_t g[3], a[3];
	int16_t rest_g[3] = {0}, rest_a[3] = {0};
	int heartbeat = 0;
	uint32_t idle_last_cyc = 0;
	uint64_t idle_frac = 0; /* sub-sample remainder, in (samples * 1e6) units */
	int missed = 0;

	block_reset(&blk);

	while (!try_imu_init()) {
		/* Keep telling the receiver we're alive but broken. */
		send_packet();
		k_msleep(IMU_RETRY_MS);
	}

	for (;;) {
		bool wired = usb_io_hid_active();
		int cur = atomic_get(&mode);

		if (wired && cur != MODE_WIRED) {
			pe_reset_motion(&engine);
			pkt.flags &= (uint8_t)~LINK_FLAG_IDLE;
			imu_drdy_irq_enable(true);
			atomic_set(&mode, MODE_WIRED);
			cur = MODE_WIRED;
		} else if (!wired && cur == MODE_WIRED) {
			atomic_set(&mode, MODE_RADIO);
			still_blocks = 0;
			cur = MODE_RADIO;
		}

		if (cur == MODE_IDLE) {
			/* Slow polling: nothing is waiting on data-ready. */
			k_usleep(IDLE_POLL_US);
			uint32_t now = k_cycle_get_32();
			uint64_t us = k_cyc_to_us_floor64(now - idle_last_cyc);

			idle_last_cyc = now;
			idle_frac += us * (uint64_t)IMU_ODR_HZ;
			uint32_t n = (uint32_t)(idle_frac / 1000000u);

			idle_frac -= (uint64_t)n * 1000000u;

			if (imu_read(g, a) != 0) {
				pkt.flags |= LINK_FLAG_IMU_ERROR;
				continue;
			}
			pkt.flags &= (uint8_t)~LINK_FLAG_IMU_ERROR;
			if (n > 0) {
				add_samples(g, a, n);
			}

			bool moved = false;

			for (int i = 0; i < 3; i++) {
				if (abs(g[i] - rest_g[i]) > WAKE_GYRO_LSB ||
				    abs(a[i] - rest_a[i]) > WAKE_ACCEL_LSB) {
					moved = true;
				}
				rest_g[i] += (int16_t)((g[i] - rest_g[i]) / 8);
			}

			if (moved) {
				atomic_set(&mode, MODE_RADIO);
				pkt.flags &= (uint8_t)~LINK_FLAG_IDLE;
				still_blocks = 0;
				block_reset(&blk);
				imu_drdy_irq_enable(true);
				send_packet();
			} else if (++heartbeat >= IDLE_HEARTBEAT_POLLS) {
				heartbeat = 0;
				send_packet();
			}
			continue;
		}

		/* Active: wait for the IMU's data-ready signal. */
		if (k_sem_take(&drdy_sem, K_MSEC(3)) != 0 && !imu_drdy_pending()) {
			/* No data for 3 ms (normal is 0.6 ms). */
			if (++missed > 300) {
				missed = 0;
				(void)try_imu_init();
			}
			continue;
		}
		missed = 0;

		if (imu_read(g, a) != 0) {
			pkt.flags |= LINK_FLAG_IMU_ERROR;
			continue;
		}
		pkt.flags &= (uint8_t)~LINK_FLAG_IMU_ERROR;
		add_samples(g, a, 1);

		if (cur == MODE_WIRED) {
			wired_process(g, a);
			continue;
		}

		if (++tx_skip >= tx_div_now()) {   /* txdiv: two rings share one radio channel */
			tx_skip = 0;
			send_packet();
		}

		bool done;
		bool still = block_add(&blk, g, &done);

		if (done) {
			still_blocks = still ? still_blocks + 1 : 0;
			if (still_blocks >= IDLE_AFTER_BLOCKS) {
				imu_drdy_irq_enable(false);
				memcpy(rest_g, g, sizeof(rest_g));
				memcpy(rest_a, a, sizeof(rest_a));
				idle_last_cyc = k_cycle_get_32();
				idle_frac = 0;
				heartbeat = 0;
				pkt.flags |= LINK_FLAG_IDLE;
				atomic_set(&mode, MODE_IDLE);
				send_packet();
			}
		}
	}
}

K_THREAD_DEFINE(motion_thread, 3072, motion_thread_fn, NULL, NULL, NULL, K_PRIO_COOP(5),
		K_FP_REGS, SYS_FOREVER_MS);

/* ------------------------------------------------------------------ */
/* Status LEDs and link statistics                                     */

static void led_pulse(const struct gpio_dt_spec *led, int ms)
{
	gpio_pin_set_dt(led, 1);
	k_msleep(ms);
	gpio_pin_set_dt(led, 0);
}

static void status_thread_fn(void *p1, void *p2, void *p3)
{
	ARG_UNUSED(p1);
	ARG_UNUSED(p2);
	ARG_UNUSED(p3);
	atomic_val_t last_ok = 0;
	int tick = 0;

	for (;;) {
		k_msleep(250);
		tick++;

		int m = atomic_get(&mode);

		if (m == MODE_WIRED) {
			struct proto_link_info li = {
				.device_id = pkt.device_id,
				.flags = pkt.flags,
				.mode = 'W',
			};

			proto_telem_link(&li);
		}

		if (!atomic_get(&imu_ok)) {
			if (tick % 4 == 0) {
				led_pulse(&led_red, 100);
			}
			continue;
		}
		if (tick % 8 != 0) {
			continue; /* one short blink every 2 s at most: saves battery */
		}
		atomic_val_t ok = atomic_get(&tx_ok_count);

		switch (m) {
		case MODE_WIRED:
			led_pulse(&led_green, 20);
			break;
		case MODE_RADIO:
			led_pulse(ok != last_ok ? &led_blue : &led_red, 20);
			break;
		default:
			break; /* idle: dark */
		}
		last_ok = ok;
	}
}

K_THREAD_DEFINE(status_thread, 1024, status_thread_fn, NULL, NULL, NULL, K_PRIO_PREEMPT(10),
		0, SYS_FOREVER_MS);

/* ------------------------------------------------------------------ */

static bool ring_cmd(int argc, char **argv)
{
	if (strcmp(argv[0], "help") == 0) {
		proto_printf("I,help,ring commands: info bootloader\n");
		return true;
	}
	if (strcmp(argv[0], "bootloader") == 0 && argc == 1) {
		/* Restart into the XIAO's UF2 drive, as a double-press of reset does
		 * (Adafruit nRF52 bootloader reads this value at boot).
		 */
		proto_printf("OK,bootloader\n");
		k_msleep(50);
		nrf_power_gpregret_set(NRF_POWER, 0, BOOTLOADER_UF2_MAGIC);
		sys_reboot(SYS_REBOOT_WARM);
		return true;
	}
	if (strcmp(argv[0], "info") == 0 && argc == 1) {
		static const char *const names[] = {"radio", "idle", "wired"};
		int m = atomic_get(&mode);

		proto_printf("I,info,id,%08x,mode,%s,imu,%s,tx_ok,%u,tx_fail,%u\n", pkt.device_id,
			     names[m], atomic_get(&imu_ok) ? "ok" : "error",
			     (unsigned int)atomic_get(&tx_ok_count),
			     (unsigned int)atomic_get(&tx_fail_count));
		proto_printf("OK,info\n");
		return true;
	}
	return false;
}

static const struct proto_hooks hooks = {
	.role = "ring",
	.extra_cmd = ring_cmd,
};

static uint32_t read_device_id(void)
{
	uint8_t id[8] = {0};
	ssize_t n = hwinfo_get_device_id(id, sizeof(id));
	uint32_t v = 0;

	for (ssize_t i = 0; i < n; i++) {
		v = (v << 8 | v >> 24) ^ id[i];
	}
	return v;
}

/*
 * XIAO nRF52840: P0.14 switches the battery-voltage divider that feeds P0.31.
 * Seeed's guidance is to keep P0.14 LOW; otherwise P0.31 can see the full
 * battery voltage while charging, which is above the chip's rated input.
 * Driving it LOW costs ~3 uA through the divider.
 */
static void protect_vbat_sense_pin(void)
{
	const struct device *gpio0 = DEVICE_DT_GET(DT_NODELABEL(gpio0));

	if (device_is_ready(gpio0)) {
		(void)gpio_pin_configure(gpio0, 14, GPIO_OUTPUT_LOW);
	}
}

int main(void)
{
	protect_vbat_sense_pin();
	gpio_pin_configure_dt(&led_red, GPIO_OUTPUT_INACTIVE);
	gpio_pin_configure_dt(&led_green, GPIO_OUTPUT_INACTIVE);
	gpio_pin_configure_dt(&led_blue, GPIO_OUTPUT_INACTIVE);
	gpio_pin_set_dt(&led_green, 1); /* boot: short green */

	pkt.type = LINK_PACKET_TYPE_MOTION;
	pkt.device_id = read_device_id();
	pkt.fw_version = FW_VERSION;

	cfg_store_init();
	struct pe_config c;

	cfg_store_get(&c, &engine_cfg_gen);
	pe_init(&engine, &c);

	proto_init(&hooks);
	(void)usb_io_init(proto_handle_line);

	int err = radio_init(ESB_MODE_PTX, esb_event);

	k_msleep(300);
	gpio_pin_set_dt(&led_green, 0);
	if (err) {
		/* Without a radio the ring still works wired. */
		gpio_pin_set_dt(&led_red, 1);
		k_msleep(1000);
		gpio_pin_set_dt(&led_red, 0);
	}

	k_thread_start(motion_thread);
	k_thread_start(status_thread);
	return 0;
}
```

## src/imu.c
```c
#include "imu.h"

#include <zephyr/drivers/gpio.h>
#include <zephyr/drivers/i2c.h>
#include <zephyr/sys/byteorder.h>

#define IMU_NODE DT_NODELABEL(lsm6ds3tr_c)

/* LSM6DS3TR-C registers */
#define REG_INT1_CTRL 0x0D
#define REG_WHO_AM_I 0x0F
#define REG_CTRL1_XL 0x10
#define REG_CTRL2_G 0x11
#define REG_CTRL3_C 0x12
#define REG_CTRL4_C 0x13
#define REG_OUTX_L_G 0x22 /* gyro X,Y,Z then accel X,Y,Z, 12 bytes */

#define WHO_AM_I_LSM6DS3TR_C 0x6A
#define WHO_AM_I_LSM6DS3 0x69

#define CTRL3_SW_RESET 0x01
#define CTRL3_BDU_IF_INC 0x44   /* block data update + register auto-increment */
#define CTRL1_XL_1666HZ_4G 0x88 /* ODR 1.66 kHz, +-4 g */
#define CTRL2_G_1666HZ_1000DPS 0x88 /* ODR 1.66 kHz, +-1000 dps */
#define INT1_DRDY_G 0x02

static const struct i2c_dt_spec bus = I2C_DT_SPEC_GET(IMU_NODE);
static const struct gpio_dt_spec int1 = GPIO_DT_SPEC_GET(IMU_NODE, irq_gpios);
static struct gpio_callback int1_cb;
static struct k_sem *drdy_sem;

static void int1_handler(const struct device *dev, struct gpio_callback *cb, uint32_t pins)
{
	ARG_UNUSED(dev);
	ARG_UNUSED(cb);
	ARG_UNUSED(pins);
	k_sem_give(drdy_sem);
}

static int wr(uint8_t reg, uint8_t val)
{
	return i2c_reg_write_byte_dt(&bus, reg, val);
}

int imu_init(struct k_sem *drdy)
{
	uint8_t id = 0;
	int err;

	drdy_sem = drdy;

	if (!i2c_is_ready_dt(&bus) || !gpio_is_ready_dt(&int1)) {
		return -ENODEV;
	}

	/* The board powers the IMU at boot; give it time if we got here fast. */
	for (int tries = 0; tries < 20; tries++) {
		err = i2c_reg_read_byte_dt(&bus, REG_WHO_AM_I, &id);
		if (err == 0) {
			break;
		}
		k_msleep(5);
	}
	if (err) {
		return err;
	}
	if (id != WHO_AM_I_LSM6DS3TR_C && id != WHO_AM_I_LSM6DS3) {
		return -ENODEV;
	}

	err = wr(REG_CTRL3_C, CTRL3_SW_RESET);
	if (err) {
		return err;
	}
	for (int tries = 0; tries < 20; tries++) {
		uint8_t v = CTRL3_SW_RESET;

		k_msleep(1);
		err = i2c_reg_read_byte_dt(&bus, REG_CTRL3_C, &v);
		if (err == 0 && !(v & CTRL3_SW_RESET)) {
			break;
		}
	}

	err = wr(REG_CTRL3_C, CTRL3_BDU_IF_INC);
	/* CTRL4_C = 0: gyro LPF1 off. The sensor's own smoothing adds delay; the
	 * pointer engine smooths only when the hand is still.
	 */
	err = err ? err : wr(REG_CTRL4_C, 0x00);
	err = err ? err : wr(REG_CTRL1_XL, CTRL1_XL_1666HZ_4G);
	err = err ? err : wr(REG_CTRL2_G, CTRL2_G_1666HZ_1000DPS);
	err = err ? err : wr(REG_INT1_CTRL, INT1_DRDY_G);
	if (err) {
		return err;
	}

	err = gpio_pin_configure_dt(&int1, GPIO_INPUT);
	if (err) {
		return err;
	}
	gpio_init_callback(&int1_cb, int1_handler, BIT(int1.pin));
	err = gpio_add_callback(int1.port, &int1_cb);
	if (err) {
		return err;
	}

	/* The gyro needs ~70 ms to start up; throw away samples until then. */
	k_msleep(100);
	int16_t g[3], a[3];

	(void)imu_read(g, a);
	imu_drdy_irq_enable(true);
	return 0;
}

int imu_read(int16_t gyro[3], int16_t accel[3])
{
	uint8_t buf[12];
	int err = i2c_burst_read_dt(&bus, REG_OUTX_L_G, buf, sizeof(buf));

	if (err) {
		return err;
	}
	for (int i = 0; i < 3; i++) {
		gyro[i] = (int16_t)sys_get_le16(&buf[2 * i]);
		accel[i] = (int16_t)sys_get_le16(&buf[6 + 2 * i]);
	}
	return 0;
}

bool imu_drdy_pending(void)
{
	return gpio_pin_get_dt(&int1) > 0;
}

void imu_drdy_irq_enable(bool enable)
{
	(void)gpio_pin_interrupt_configure_dt(&int1, enable ? GPIO_INT_EDGE_TO_ACTIVE
							    : GPIO_INT_DISABLE);
}
```

## src/imu.h
```c
/*
 * Minimal driver for the LSM6DS3TR-C on the XIAO nRF52840 Sense.
 * Talks to the registers directly (not the Zephyr sensor API) so every
 * sample is read the moment it is ready, with no extra buffering.
 */
#ifndef IMU_H_
#define IMU_H_

#include <stdbool.h>
#include <stdint.h>

#include <zephyr/kernel.h>

/* Set up the sensor: 1666 Hz, +-1000 dps gyro, +-4 g accel, data-ready on INT1.
 * `drdy` is given every time a new sample is ready.
 */
int imu_init(struct k_sem *drdy);

/* Read the latest gyro + accel sample (raw LSB). Clears the data-ready line. */
int imu_read(int16_t gyro[3], int16_t accel[3]);

/* Level of the data-ready line (true = a sample is waiting). */
bool imu_drdy_pending(void);

/* Enable/disable the data-ready interrupt (disabled in idle mode, where the
 * ring polls slowly instead).
 */
void imu_drdy_irq_enable(bool enable);

#endif /* IMU_H_ */
```

## src/usb_ids.h
```c
/* USB identity of the ring when plugged in (wired mode). */
#define USB_IO_PID 0x0002
#define USB_IO_PRODUCT "Pointer Ring (wired)"
#define USB_IO_MAX_POWER_2MA 100 /* 200 mA: board + battery charging */
```
